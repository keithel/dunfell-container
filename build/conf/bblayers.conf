## build/conf/bblayers.conf
```bitbake
# POKY_BBLAYERS_CONF_VERSION is increased each time build/conf/bblayers.conf
# changes incompatibly
POKY_BBLAYERS_CONF_VERSION = "2"

BBPATH = "${TOPDIR}"
BBFILES ?= ""

BBLAYERS ?= " \
  /home/kyzik/Build/yocto/dunfell-container/poky/meta \
  /home/kyzik/Build/yocto/dunfell-container/poky/meta-poky \
  /home/kyzik/Build/yocto/dunfell-container/poky/meta-yocto-bsp \
  ../meta-qt5 \
  ../meta-openembedded/meta-oe \
  ../meta-openembedded/meta-python \
  ../meta-mingw \
  ../meta-openembedded/meta-networking \
  ../meta-boot2qt/meta-boot2qt \
  ../meta-boot2qt/meta-boot2qt-distro \
  /home/kyzik/Build/yocto/dunfell-container/meta-helloworld \
  "

#  /home/kyzik/Build/yocto/dunfell-container/meta-example
```
